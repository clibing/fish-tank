## main/Kconfig.projbuild
```kconfig
menu "Fish Tank"
    menu "Global Configuration"
        config GLOBAL_DEBUG
            bool "Global debugging debug switch"
            default "y"
            help
                Global log level. When enabled, all log levels will be set

        config WiFi_DEFAULT_ENABLE
            bool "Whether to use the default WiFi configuration"
            default "n"
            help
                The default WiFi is station configuration. You need to configure the name and password of the hotspot.

        config MQTT_ENABLED
            bool "Is the mqtt module available"
            default "y"
            help
                Select this option to enable MQTT and show the submenu with MQTT configuration choices.

        config OLED_ENABLED
            bool "Whether OLED can use SPI"
            default "y"
            help
                Select this option to enable OLED and show the submenu with OLED configuration choices.
    endmenu

    menu "GPIO Pin Mode"
        menu "ESP8266 GPIO Pin number"
            visible if IDF_TARGET_ESP8266

            config SMART_CONFIG_BTN_PIN
                int "Smartconfig one key distribution network pin"
                default 13
                help
                    Pin triggering smartconfig one key distribution network key

            config WATER_PUMP_PIN
                int "Water pump switch"
                default 14
                help
                    Water pump control pin

            config O2_PUMP_PIN
                int "O2 pump control pin"
                default 15
                help
                    O2 pump control pin

            config LED_PIN
                int "LED control pin"
                default 12
                help
                    LED control pin

            config DHT_PIN
                int "DHT11 data pin"
                default 2
                help
                    DHT11 data pin
        endmenu
        
        menu "ESP32 GPIO Pin number"
            visible if IDF_TARGET_ESP32

            config SMART_CONFIG_BTN_PIN
                int "Smartconfig one key distribution network pin"
                default 5
                help
                    Pin triggering smartconfig one key distribution network key
        endmenu
    endmenu

    menu "MQTT Configuration"
        visible if MQTT_ENABLED

        config BROKER_URI
            string "Broker URL"
            default "mqtts://mqtt.clibing.com:8883"
            help
                URL of an mqtt broker which this example connects to.

        config CLIENT_ID 
            string "Mqtt Client Id"
            default "01-0001"
            help
                Unique identification of equipment, 01: esp8266, 02: esp32, 0001:Device number

        config MQTT_USER_NAME
            string "Mqtt user name"
            default "guest"
            help
                Account number for accessing mqtt

        config MQTT_PASSWORD
            string "Mqtt password"
            default "guest"
            help
                Password for accessing mqtt

        config DEVICE_TOPIC_PRE 
            string "Device topic "
            default "/Topic/"
            help
                Device topic will reveive message, Splicing with chip ID

        config SYS_TOPIC
            string "System topic"
            default "/System"
            help
                System topic will receive sys message, such as report message, fireware upgrade, other 

        config REPORT_TOPIC
            string "Report host info topic"
            default "/Report"
            help
                Current basic information and function pin status will be reported


        config ONLINE_TOPIC
            string "Onlien topic"
            default "/Online"
            help
                Send a message to the topic when the device goes online.

        config OFFLINE_TOPIC
            string "Offline topic"
            default "/Offline"
            help
                Device offline, will send lwt message when device power off or mqtt disconnection.
    endmenu

    menu "WiFi Default Configuration"
        visible if WiFi_DEFAULT_ENABLE

        config WIFI_SSID
            string "Access to ssid of WiFi"
            default "Redmi"
            help
                Default access to SSID of WiFi.

        config WIFI_PWD
            string "Access to password of WiFi"
            default "123456987"
            help
                Default access to password of WiFi.
    endmenu

    menu "OLED Configuration"
        visible if OLED_ENABLED

        config SSD1306_ENABLED
            bool "Whether OLED SSD1306 can use SPI"
            default "n"
            help
                Select this option to enable SSD1306 and show the submenu with SSD1306 configuration choices.

        menu "OLED SSD1306 Configuration"
            visible if SSD1306_ENABLED

            menu "OLED SSD1306 ESP8266 Configuration"
                visible if IDF_TARGET_ESP8266
                config OLED_SCL_PIN
                    int "SCL GPIO pin of OLED"
                    default 5
                    help
                        SCL GPIO pin of OLED, this pin control serial clock input

                config OLED_SDA_PIN
                    int "SDA GPIO pin of OLED"
                    default 4
                    help
                        SDA GPIO pin of OLED, this pin control Serial data input

            endmenu

            menu "OLED SSD1306 ESP32 Configuration"
               visible if IDF_TARGET_ESP32
               config OLED_RESET_OUTPUT_PIN
                   int "Reset GPIO pin of OLED"
                   default 23
                   help
                       Reset GPIO pin of OLED, this pin control screen

               config OLED_SCL_PIN
                   int "SCL GPIO pin of OLED"
                   default 32
                   help
                       SCL GPIO pin of OLED, this pin control serial clock input

               config OLED_SDA_PIN
                   int "SDA GPIO pin of OLED"
                   default 33
                   help
                       SDA GPIO pin of OLED, this pin control Serial data input
            endmenu

        endmenu

    endmenu

endmenu
```
